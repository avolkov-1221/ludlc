## src/lib/platform/linux/Kconfig
```kconfig
# SPDX-License-Identifier: GPL-2.0-only
#
# @file Kconfig
#
# @brief Kconfig options of the LuDLC Linux drivers, for an in-tree build.
#
# @copyright
# Copyright (C) 2025-2026 Andrey VOLKOV <andrey@volkov.fr> & LuDLC Contributors
#
# @details
# The core module, the default checksum, and the serdev and SPI transports. An
# out-of-tree build makes the same choices in the Makefile beside this file.

config LUDLC_CORE
	tristate "LuDLC core glue"
	help
	  Platform glue required to run LuDLC core logic inside the Linux
	  kernel. This module provides timer/event integration and a lightweight
	  software bus used by LuDLC transports.

	  It also holds the checksums a link can run. Both ends of a link must
	  agree on the checksum, which makes it a property of the link rather
	  than of whatever carries it, so every transport picks one from here.

if LUDLC_CORE

choice
	prompt "Default frame checksum"
	default LUDLC_CRC_DFLT_CCITT_PR0
	help
	  The checksum a link uses when nothing else names one: neither the
	  crc= module parameter, a ludlc,csum firmware property nor a configfs
	  write.

	  Both ends of a link must agree on it, so this belongs to the network
	  rather than to the driver. Change it only to match the peers.

	  A link may run anything from 8 to 64 bits, so only the default needs
	  a CRC library here; a link can be pointed at any other checksum,
	  including one another module registers.

config LUDLC_CRC_DFLT_CCITT_PR0
	bool "CRC-16/KERMIT (crc16-ccitt-pr0)"
	select CRC_CCITT
	help
	  Reflected 0x1021 seeded with zero, computed by the kernel
	  crc_ccitt_byte() and leaving residual zero at the far end. Two
	  octets per frame. This is what the other LuDLC platforms send, so
	  keep it unless the network has settled on something else.

config LUDLC_CRC_DFLT_X25_PR1
	bool "HDLC FCS-16 (crc16-x25-pr1)"
	select CRC_CCITT
	help
	  The same reflected 0x1021, but seeded with all ones and
	  complemented on output, as X.25 and PPP send it. The far end is
	  left with residual 0xf0b8 rather than zero. Two octets per frame,
	  and no wider a check than the choice above.

config LUDLC_CRC_DFLT_CRC16_PR0
	bool "CRC-16/ARC (crc16-pr0)"
	select CRC16
	help
	  Reflected 0x8005 seeded with zero, computed by the kernel
	  crc16_byte() and leaving residual zero. Two octets per frame. The
	  other 16-bit CRC the kernel provides, for a network that has
	  settled on this polynomial.

config LUDLC_CRC_DFLT_CRC32_PR0
	bool "CRC-32, zero seed (crc32-ccitt-pr0)"
	select CRC32
	help
	  Reflected 0x04c11db7 seeded with zero, computed by the kernel
	  crc32_le() and leaving residual zero. For a link that wants more
	  than 16 bits of protection, at four octets per frame instead of
	  two.

config LUDLC_CRC_DFLT_NONE
	bool "No checksum (none)"
	help
	  Frames carry no checksum: none is computed, sent or checked. For a
	  network whose transports validate frames themselves, or whose links
	  each choose a checksum of their own. Needs no CRC library.

endchoice

endif

config LUDLC_SERDEV
	tristate "LuDLC serdev transport"
	depends on LUDLC_CORE && SERIAL_DEV_BUS
	help
	  Serial transport implementation for LuDLC using the Linux serdev
	  subsystem.

	  A link here delimits its frames either in the manner of HDLC, which
	  suits a byte stream that may start anywhere, or with COBS, which
	  costs a fixed octet per frame rather than one per reserved octet in
	  it. Both ends must agree, so a link takes its framing from the
	  "framing" module parameter, a "ludlc,framing" firmware property or a
	  configfs write, and falls back on the escaping.

	  Say M here to build it as a module, ludlc_serdev.

config LUDLC_SPI_MASTER
	tristate "LuDLC SPI master transport"
	depends on LUDLC_CORE && SPI_MASTER
	help
	  Transport for a LuDLC link to a peer on an SPI bus this system
	  drives. Every exchange says how long its frame is before sending it,
	  so a frame goes out as it stands and the rest of the transfer is
	  padding; COBS is there for a peer that expects the stuffed form.
	  Both ends must agree, so a link takes its framing from the "framing"
	  module parameter, a "ludlc,framing" firmware property or a configfs
	  write, and falls back on the frame as it stands. The peer asks to be
	  heard over a data-ready line described alongside it.

	  Say M here to build it as a module, ludlc_spi_master.
```

## src/samples/zephyr/ludlc_echo/Kconfig.sample
```kconfig
# SPDX-License-Identifier: (Apache-2.0 OR GPL-2.0-or-later)
#
# @file Kconfig.sample
#
# @brief Options of the echo sample.
#
# @copyright
# Copyright (C) 2025-2026 Andrey VOLKOV <andrey@volkov.fr> & LuDLC Contributors

if LUDLC

menu "Echo sample"

config LUDLC_ECHO_PERIODIC_TX
	bool "Enable periodic ECHO packet transmission"
	default y
	help
	  This option controls whether the echo sample generates its own
	  periodic ECHO traffic. When enabled, the sample transmits one ECHO
	  packet per second in addition to normal reply traffic triggered by
	  received packets. When disabled, the sample operates in reply-only
	  mode and sends ECHO packets only as direct responses to peer input.

config LUDLC_ECHO_SPI
	bool "Run the echo link over SPI rather than over a UART"
	default n
	depends on LUDLC_SPI_CONN
	help
	  Put the link on the SPI peripheral this board describes, with
	  the Linux ludlc_spi_master driver as the controller, instead of
	  on uart0. The board overlay says which peripheral and which
	  GPIO carries the data-ready line; without such a line the
	  controller has to poll.

	  The sample logic is the same either way: only which transport
	  the connection is created on changes.

endmenu

endif
```

## src/samples/zephyr/ludlc_echo/sample.yaml
```yaml
# SPDX-License-Identifier: (Apache-2.0 OR GPL-2.0-only)
#
# @file sample.yaml
#
# @brief Twister description of the echo sample.
#
# @copyright
# Copyright (C) 2025-2026 Andrey VOLKOV <andrey@volkov.fr> & LuDLC Contributors

sample:
  name: LuDLC echo sample
tests:
  sample.ludlc.echo.native_sim:
    build_only: true
    platform_allow:
      - native_sim
    integration_platforms:
      - native_sim
    tags:
      - ludlc
      - serial
      - uart
  sample.ludlc.echo.spi:
    build_only: true
    platform_allow:
      - nucleo_g0b1re
    integration_platforms:
      - nucleo_g0b1re
    tags:
      - ludlc
      - spi
```

## tests/zephyr/ludlc_module_smoke/testcase.yaml
```yaml
# SPDX-License-Identifier: (Apache-2.0 OR GPL-2.0-only)
#
# @file testcase.yaml
#
# @brief Twister description of the Zephyr module smoke test.
#
# @copyright
# Copyright (C) 2025-2026 Andrey VOLKOV <andrey@volkov.fr> & LuDLC Contributors

tests:
  modules.ludlc.smoke.native_sim:
    build_only: true
    platform_allow:
      - native_sim
    integration_platforms:
      - native_sim
    tags:
      - ludlc
      - zephyr
```

## zephyr/Kconfig
```kconfig
# SPDX-License-Identifier: (Apache-2.0 OR GPL-2.0-or-later)
#
# @file Kconfig
#
# @brief Kconfig options of the LuDLC Zephyr module.
#
# @copyright
# Copyright (C) 2025-2026 Andrey VOLKOV <andrey@volkov.fr> & LuDLC Contributors

menu "LuDLC"

config LUDLC
	bool "LuDLC stack"
	default n
	help
	  Enable the LuDLC.

if LUDLC

config LUDLC_MT
	bool
	default y

config LUDLC_WINDOW
	int "Transmit window size"
	range 1 256
	default 4
	help
	  Largest sliding-window size a connection may use. Must be a power
	  of two. With LUDLC_MULTI_CONN a link may run a smaller window via
	  its ludlc_conn_cfg.

config LUDLC_CONFIRM_BATCH
	int "Confirmations reported per lock acquisition"
	range 1 256
	default 4
	depends on LUDLC_MT
	help
	  How many confirmations are carried out of the connection lock at a
	  time, on the stack of the thread reporting them. This bounds the
	  stack rather than the work: a larger value takes the lock fewer
	  times when a whole window is confirmed at once, and costs
	  LUDLC_CONFIRM_BATCH * sizeof(struct packet_queue_item) of stack
	  while draining.

	  Set it to LUDLC_WINDOW for a single pass, which is what a small
	  window wants. Leave it lower for a window of tens or hundreds,
	  where a batch that size is more stack than a confirmation is worth.

config LUDLC_MULTI_CONN
	bool "Per-connection protocol settings"
	default n
	help
	  When disabled, every link runs LUDLC_CONN_CFG_DEFAULT (the CONFIG_*
	  values for window, payload size, ping period and default TTL).

	  When enabled, each link carries a ludlc_conn_cfg in the platform
	  args: window (up to LUDLC_WINDOW), max_payload, ping_time and
	  default_ttl may differ per connection.

config LUDLC_ID_BITS
	int "Packet ID width (bits)"
	range 8 32
	default 8
	help
	  Bit-width of packet IDs. Supported values: 8, 16, 32.

config LUDLC_PING_TIME
	int "Ping period in microseconds"
	range 1 2147483647
	default 1000000
	help
	  Keepalive ping period used by the protocol timers.

config LUDLC_PAYLOAD_BITS
	int "Payload-size type width (bits)"
	range 8 32
	default 8
	help
	  Bit-width of payload length fields. Supported values: 8, 16, 32.

config LUDLC_FRAME_BITS
	int "Frame-size type width (bits)"
	range 8 64
	default 16
	help
	  Bit-width of frame length fields. A frame is the link's payload plus
	  a header and a checksum; this type must be able to name that size
	  after any stuffing a framing adds (for example COBS on SPI). COBS's
	  255-octet stuffing group is not the frame size. Supported values:
	  8, 16, 32, 64.

config LUDLC_MAX_PAYLOAD_SIZE
	int "Maximum payload size (bytes)"
	range 1 255 if LUDLC_PAYLOAD_BITS = 8
	range 1 65535 if LUDLC_PAYLOAD_BITS = 16
	range 1 4294967295 if LUDLC_PAYLOAD_BITS = 32
	default 32
	help
	  Maximum packet payload size (unsigned).
	  The effective upper limit follows LUDLC_PAYLOAD_BITS:
	  255 for 8-bit payload length, 65535 for 16-bit, and
	  4294967295 for 32-bit.

config LUDLC_CHANNEL_BITS
	int "Channel ID width (bits)"
	range 8 32
	default 8
	help
	  Bit-width of channel identifiers. Supported values: 8, 16, 32.

config LUDLC_CONTROL_CHANNEL
	int "Reserved control channel"
	default 0
	help
	  Reserved channel used for handshake/control packets.

config LUDLC_DEFAULT_TTL
	int "Default transmit retry budget (TTL)"
	range 1 126
	default 4
	help
	  Default retry count for queued packets.

config LUDLC_CSUM_BITS
	int "Checksum type width (bits)"
	range 8 64
	default 16
	help
	  Bit-width of checksum type. Supported values: 8, 16, 32, 64.

config LUDLC_TIMESTAMP_BITS
	int "Timestamp type width (bits)"
	range 8 64
	default 64
	help
	  Bit-width of timestamp type. Supported values: 8, 16, 32, 64.

config LUDLC_STATS
	bool "Enable LuDLC runtime statistics"
	default y
	help
	  This option stores runtime protocol counters in each connection
	  state, including transmit activity, receive activity, and error
	  events. The counters are useful for diagnostics, validation, and
	  field troubleshooting because they expose protocol behavior over
	  time. Disable this option only when minimizing memory footprint is
	  more important than runtime observability.

config LUDLC_FRAMING_HDLC
	bool "HDLC framing"
	default y
	help
	  Delimit a frame with LUDLC_SOF, and escape that octet and LUDLC_ESC
	  where they occur inside the frame. A frame grows by one octet per
	  occurrence, so the worst case is twice its length.

config LUDLC_FRAMING_COBS
	bool "COBS framing"
	default y
	help
	  Delimit a frame with LUDLC_COBS_DELIMITER and remove that octet from
	  inside the frame, so a frame grows by one octet per 254 rather than
	  by its content. Costs more code than the escaping and about the same
	  RAM.

config LUDLC_FRAMING_RAW
	bool "Raw framing"
	default y
	help
	  Send the octets unchanged, with no delimiter. Usable only where the
	  transport delimits frames itself, which here means SPI, where the
	  length is announced before each frame.

config LUDLC_STATIC_FRAMING_NUM
	int "Framing objects preallocated per framing"
	default 1 if !LUDLC_MULTI_CONN
	default 0
	help
	  How many links can open at once before the framing calls k_calloc().
	  Every framing preallocates this many objects, so set it to the number
	  of links that may run the same framing. The default of one covers a
	  build with one framing and one link. At zero, every link takes its
	  framing from the heap, which then has to be enabled.

config LUDLC_SERIAL_CONN
	bool "LuDLC Serial connection support"
	default n
	depends on SERIAL
	# For the CRC-16/KERMIT of the default args, and for an application
	# that brings its own checksum.
	select CRC
	select EVENTS
	help
	  Build LuDLC with serial (UART) connection support. A link delimits
	  its frames with the HDLC escaping unless the application asks for
	  COBS instead.

config LUDLC_STATIC_SERIAL_CONN
	bool "Predefine LuDLC Serial connection as static array"
	default n
	depends on LUDLC_SERIAL_CONN

config LUDLC_STATIC_SERIAL_CONN_NUM
	int "Number of predefine connections"
	default 1
	depends on LUDLC_STATIC_SERIAL_CONN

config LUDLC_NUM_RX_BUFFERS
	int "Number of RX packet buffers"
	range 1 64
	default 3
	depends on LUDLC_SERIAL_CONN
	help
	  Number of RX packet buffers used by Zephyr serial transport.

menu "Sample options"

rsource "../src/samples/zephyr/ludlc_echo/Kconfig.sample"

endmenu

endif # LUDLC

endmenu
```

## zephyr/dts/bindings/ludlc/ludlc,link-common.yaml
```yaml
# SPDX-License-Identifier: (Apache-2.0 OR GPL-2.0-only)
#
# @file ludlc,link-common.yaml
#
# @brief Devicetree binding of the properties both ends of a LuDLC link must
# agree on.
#
# @copyright
# Copyright (C) 2025-2026 Andrey VOLKOV <andrey@volkov.fr> & LuDLC Contributors

description: |
  The properties of a LuDLC link whatever carries it, for the binding of a node
  describing one end of a link to include, as ludlc,uart and
  ludlc,spi-peripheral do:

    include: ludlc,link-common.yaml

  Both ends of a link have to agree on all of them, so the other end describes
  them with the same names and values. A Linux end reads them through the
  binding of the same name in src/lib/platform/linux/, which is in the
  dt-schema format and cannot be included here; the two files change together.

  Only keys every recent Zephyr release accepts are used, since an included
  file is merged into the binding that includes it. The ranges are therefore
  given in the descriptions, and the core checks them when the link opens.

properties:
  ludlc,framing:
    type: string
    enum:
      - "cobs"
      - "hdlc"
      - "raw"
    description: |
      How a frame is delimited on the wire. Both ends must agree, and each
      transport takes only the framings its wire can carry: hdlc and cobs on
      a UART, raw and cobs on SPI.

  ludlc,csum:
    type: string
    enum:
      - "none"
      - "crc16-ccitt-pr0"
      - "crc16-pr0"
      - "crc16-x25-pr1"
      - "crc32-ccitt-pr0"
    description: |
      The frame checksum, named for the algorithm and the bit order it is
      computed in, or none for frames that carry no checksum. Both ends must
      agree.

  ludlc,max-payload:
    type: int
    description: |
      The largest payload the link carries, in octets, at least 1. The
      transport adds the header and the checksum to get the frame. It is the
      peer's limit that matters, the smaller of the two ends deciding.

  ludlc,channel-tag-bits:
    type: int
    default: 0
    description: |
      How many top bits of the channel field carry a tag for the application
      rather than select a channel. A link with 32 channels on an 8-bit field
      can spare 3. The tag must leave at least one bit to the channel, and
      room for the control channel below it. Both ends must agree.
```
