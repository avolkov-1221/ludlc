## zephyr/dts/bindings/ludlc/ludlc,spi-peripheral.yaml
```yaml
# SPDX-License-Identifier: (Apache-2.0 OR GPL-2.0-or-later)
#
# @file ludlc,spi-peripheral.yaml
#
# @brief Devicetree binding of a LuDLC link on an SPI bus that another
# controller drives.
#
# @copyright
# Copyright (C) 2025-2026 Andrey VOLKOV <andrey@volkov.fr> & LuDLC Contributors

description: |
  A LuDLC link on an SPI bus the peer drives, with this system as the
  peripheral, described as a device on the SPI controller that runs in
  peripheral mode. reg is the chip select this end answers on,
  spi-max-frequency the fastest clock the peer drives, and spi-cpol,
  spi-cpha and spi-lsb-first the mode it clocks in, which both ends must
  share. What the link runs comes from ludlc,link-common.yaml. A Linux peer
  describes its end of the same link with ludlc,spi.

  An application opens the link with the arguments
  LUDLC_SPI_PERIPHERAL_ARGS_DT() from ludlc_dt.h builds, and the SPI
  transport is on by default while such a node is enabled.

  Nothing moves on the bus until the peer clocks it, so this end asks for an
  exchange on the data-ready line. An exchange is two transfers, the lengths
  each end has to send and then the frames, and the chip select is released
  in between while this end sets up the second.

  Example:

    &spi1 {
        status = "okay";

        ludlc-link@0 {
            compatible = "ludlc,spi-peripheral";
            reg = <0>;
            spi-max-frequency = <DT_FREQ_M(8)>;
            data-ready-gpios = <&gpioc 7 GPIO_ACTIVE_HIGH>;
            ludlc,csum = "crc16-ccitt-pr0";
        };
    };

compatible: "ludlc,spi-peripheral"

include:
  - name: spi-device.yaml
  - name: ludlc,link-common.yaml
    property-blocklist:
      - ludlc,framing

properties:
  ludlc,framing:
    type: string
    enum:
      - "cobs"
      - "raw"
    default: "raw"
    description: |
      How a frame is delimited on the wire. Both ends must agree. The length
      announced before a frame delimits it, so raw adds nothing to the frame;
      cobs is for a peer that already runs it on a UART. hdlc cannot be used
      here, as its length is not known until the frame has been escaped.

  data-ready-gpios:
    type: phandle-array
    description: |
      The line this end raises to ask the peer for an exchange, which only
      the peer can start. Without it the peer polls, and a frame this end has
      ready waits for the next poll.
```

## zephyr/dts/bindings/ludlc/ludlc,uart.yaml
```yaml
# SPDX-License-Identifier: (Apache-2.0 OR GPL-2.0-or-later)
#
# @file ludlc,uart.yaml
#
# @brief Devicetree binding of a LuDLC link on a UART.
#
# @copyright
# Copyright (C) 2025-2026 Andrey VOLKOV <andrey@volkov.fr> & LuDLC Contributors

description: |
  A LuDLC link on the serial line between this system and its peer, described
  as a device on the UART that carries it. The line settings are the UART's
  own, current-speed and the rest; what the link runs comes from
  ludlc,link-common.yaml. A Linux peer describes its end of the same link
  with ludlc,serdev.

  Example:

    &usart1 {
        status = "okay";
        current-speed = <921600>;

        ludlc-link {
            compatible = "ludlc,uart";
            ludlc,framing = "hdlc";
            ludlc,csum = "crc16-ccitt-pr0";
            ludlc,max-payload = <32>;
        };
    };

compatible: "ludlc,uart"

include:
  - name: uart-device.yaml
  - name: ludlc,link-common.yaml
    property-blocklist:
      - ludlc,framing

properties:
  ludlc,framing:
    type: string
    enum:
      - "cobs"
      - "hdlc"
    default: "hdlc"
    description: |
      How a frame is delimited on the wire. Both ends must agree. A UART does
      not mark where a frame ends, so the framing has to, and raw cannot be
      used here.
```
