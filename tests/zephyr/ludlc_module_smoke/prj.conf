## CMakeLists.txt
```
# SPDX-License-Identifier: (Apache-2.0 OR GPL-2.0-or-later)
#
# @file CMakeLists.txt
#
# @brief Builds the Zephyr module smoke test.
#
# @copyright
# Copyright (C) 2025-2026 Andrey VOLKOV <andrey@volkov.fr> & LuDLC Contributors

cmake_minimum_required(VERSION 3.20.0)
find_package(Zephyr REQUIRED HINTS $ENV{ZEPHYR_BASE})
project(ludlc_module_smoke)

target_sources(app PRIVATE src/main.c)
```

## prj.conf
```kconfig
# SPDX-License-Identifier: (Apache-2.0 OR GPL-2.0-or-later)
#
# @file prj.conf
#
# @brief Kconfig settings of the Zephyr module smoke test.
#
# @copyright
# Copyright (C) 2025-2026 Andrey VOLKOV <andrey@volkov.fr> & LuDLC Contributors

CONFIG_LUDLC=y
```

## src/main.c
```c
// SPDX-License-Identifier: (Apache-2.0 OR GPL-2.0-or-later)
/**
 * @file ludlc_module_smoke/src/main.c
 *
 * @brief Checks that an application can build against the LuDLC Zephyr module.
 *
 * @copyright
 * Copyright (C) 2025-2026 Andrey VOLKOV <andrey@volkov.fr> & LuDLC Contributors
 *
 * @details
 * A build-smoke target: it includes the public header and takes the size of
 * a connection pointer, so it passes once the module and its headers build
 * in an application. Nothing is tested at run time.
 */

#include <zephyr/kernel.h>
#include <zephyr/sys/util.h>

#include <ludlc.h>

int main(void)
{
	ARG_UNUSED(sizeof(struct ludlc_connection *));

	return 0;
}
```
